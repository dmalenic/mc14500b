#ifndef _MEMORY_MAP_H
#define _MEMORY_MAP_H

#include <Arduino.h>


////////////////////////////////////////////////////////////////////
// RAM
////////////////////////////////////////////////////////////////////

#define MEMORY_START  ((word) 0b0000)
#define MEMORY_END    ((word) 0b0111)
byte MEMORY[MEMORY_END-MEMORY_START+1];

// 000000r 2               MEM0 = $0
// 000000r 2               MEM1 = $1
// 000000r 2               MEM2 = $2
// 000000r 2               MEM3 = $3
// 000000r 2               MEM4 = $4
// 000000r 2               MEM5 = $5
// 000000r 2               MEM6 = $6
// 000000r 2               MEM7 = $7
// 000000r 2               
// 000000r 2               RR = $8      // RR bit instead of IN0 !!
// 000000r 2               IN1 = $9
// 000000r 2               IN2 = $A
// 000000r 2               IN3 = $B
// 000000r 2               IN4 = $C
// 000000r 2               IN5 = $D
// 000000r 2               IN6 = $E
// 000000r 2               IN7 = $F
// 000000r 2               
// 000000r 2               OUT0 = $8
// 000000r 2               OUT1 = $9
// 000000r 2               OUT2 = $A
// 000000r 2               OUT3 = $B
// 000000r 2               OUT4 = $C
// 000000r 2               OUT5 = $D
// 000000r 2               OUT6 = $E
// 000000r 2               OUT7 = $F

////////////////////////////////////////////////////////////////////
// ROM
////////////////////////////////////////////////////////////////////
// Convert bin to hex at http://tomeko.net/online_tools/file_to_hex.php?lang=en

// ROMs
#define ROM_START           ((word) 0x0000)
#define ROM_END             ((word) (ROM_START+sizeof(rom_bin)-1))
#define ROM                 rom_bin

////////////////////////////////////////////////////////////////////
// Monitor Code
////////////////////////////////////////////////////////////////////
#define STORE_ROM_IN_FLASH  0  // 0: Save ROM in RAM, 1: Save ROM in FLASH (uneditable in shell)


#if STORE_ROM_IN_FLASH
const unsigned char rom_bin[] PROGMEM = {
#else
unsigned char rom_bin[] = {
#endif

//  0     1     2     3     4     5     6     7     8     9     A     B     C     D     E     F
    0x68, 0xA8, 0xB8, 0x19, 0xE0, 0xC1, 0x98, 0x8D, 0x00, 0x00, 0x00, 0x00, 0x19, 0xE0, 0xC2, 0x99,
    0x88, 0x00, 0x00, 0x00, 0x00, 0x19, 0xE0, 0xC3, 0x9A, 0x89, 0x00, 0x00, 0x00, 0x00, 0x19, 0xE0,
    0xC4, 0x9B, 0x8A, 0x00, 0x00, 0x00, 0x00, 0x19, 0xE0, 0xC5, 0x9C, 0x8B, 0x00, 0x00, 0x00, 0x00,
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    0x19, 0xE0, 0xCF, 0xC0, 0x00, 0x00, 0x00, 0x00, 0x00, 0x00, 0x00, 0x00, 0x00, 0x00, 0x00, 0x00,

};

////////////////////////////////////////////////////////////////////
// Used by RetroShell to access ROM
////////////////////////////////////////////////////////////////////

byte rom_read_byte(word addr)
{
  #if STORE_ROM_IN_FLASH
    if ((addr >= ROM_START) && (addr <= ROM_END ))
      return pgm_read_byte_near(ROM + (addr - ROM_START));
    else
      return 0;
  #else
    if ((addr >= ROM_START) && (addr <= ROM_END))
      return ROM[addr - ROM_START];
    else
      return 0;
  #endif
}

bool rom_write_byte(word addr, byte value)
{
  #if STORE_ROM_IN_FLASH
    Serial.println("ERR: Can not update ROM in FLASH.");
    return false;
  #else
    if ((addr >= ROM_START) && (addr <= ROM_END)) 
      ROM[addr - ROM_START] = value;
    return true;
  #endif
}


#endif // _MEMORYMAP_H
